// SPDX-License-Identifier: GPL-2.0-only

/dts-v1/;

#include "msm8916-samsung-fortuna-common.dtsi"

/ {
	model = "Samsung Galaxy Grand Prime (SM-G530H)";
	compatible = "samsung,fortuna3g", "qcom,msm8916";
	chassis-type = "handset";
};

&mpss_mem {
	reg = <0x0 0x86800000 0x0 0x5000000>;
};

&st_accel {
	status = "okay";
};

&st_magn {
	status = "okay";
};
